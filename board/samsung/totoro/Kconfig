## board/samsung/totoro/Kconfig
```kconfig
if TARGET_TOTORO
config SYS_BOARD
	default "totoro"
config SYS_VENDOR
	default "samsung"
config SYS_CONFIG_NAME
	default "totoro"
endif
```

## configs/totoro_defconfig
```kconfig
CONFIG_ARM=y
CONFIG_TARGET_TOTORO=y
CONFIG_TEXT_BASE=0x81609000
CONFIG_SYS_MALLOC_LEN=0x200000
CONFIG_NR_DRAM_BANKS=1
CONFIG_HAS_CUSTOM_SYS_INIT_SP_ADDR=y
CONFIG_CUSTOM_SYS_INIT_SP_ADDR=0x81000000
CONFIG_ENV_SIZE=0x2000
CONFIG_ENV_IS_NOWHERE=y
CONFIG_SYS_LOAD_ADDR=0x82000000
CONFIG_BOOTDELAY=0
CONFIG_USE_BOOTCOMMAND=y
CONFIG_BOOTCOMMAND="totoro"
CONFIG_BOARD_LATE_INIT=y
CONFIG_BOARD_EARLY_INIT_F=y
# CONFIG_DISPLAY_CPUINFO is not set
CONFIG_SYS_PROMPT="totoro => "
CONFIG_HUSH_PARSER=y
CONFIG_CMD_MEMORY=y
# CONFIG_NET is not set
CONFIG_MMC=y
CONFIG_MMC_SDHCI=y
CONFIG_CMD_MMC=y
CONFIG_CMD_FAT=y
CONFIG_FAT_WRITE=y
CONFIG_CMD_EXT4=y
CONFIG_CMD_FS_GENERIC=y
CONFIG_DOS_PARTITION=y
CONFIG_EFI_PARTITION=y
CONFIG_CMD_ELF=y
CONFIG_CMD_GO=y
CONFIG_CMD_SOURCE=y
CONFIG_USB=y
CONFIG_USB_GADGET=y
# CONFIG_DM_USB_GADGET is not set
CONFIG_USB_GADGET_DWC2_OTG=y
CONFIG_USB_GADGET_DWC2_OTG_PHY_BUS_WIDTH_8=y
CONFIG_USB_GADGET_DOWNLOAD=y
CONFIG_USB_FUNCTION_MASS_STORAGE=y
CONFIG_USB_FUNCTION_ACM=y
CONFIG_USB_FUNCTION_FASTBOOT=y
CONFIG_FASTBOOT_BUF_ADDR=0x82000000
CONFIG_FASTBOOT_BUF_SIZE=0x01000000
# CONFIG_FASTBOOT_FLASH is not set
# CONFIG_ANDROID_BOOT_IMAGE is not set
CONFIG_CMD_USB_MASS_STORAGE=y
CONFIG_USB_GADGET_MANUFACTURER="Totoro experimental"
CONFIG_USB_GADGET_VENDOR_NUM=0x0525
CONFIG_USB_GADGET_PRODUCT_NUM=0xa4a7
CONFIG_CONSOLE_MUX=y
# CONFIG_DM is not set
CONFIG_OF_CONTROL=y
CONFIG_OF_EMBED=y
CONFIG_DEFAULT_DEVICE_TREE="totoro"
# CONFIG_OF_UPSTREAM is not set
# CONFIG_EFI_LOADER is not set
# CONFIG_TOOLS_MKEFICAPSULE is not set
CONFIG_SYS_ICACHE_OFF=y
CONFIG_SYS_DCACHE_OFF=y
```
